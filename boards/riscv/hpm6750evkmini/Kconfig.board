## boards/riscv/hpm6750evkmini/Kconfig.board
```kconfig
# Copyright (c) 2022 hpmicro
# SPDX-License-Identifier: Apache-2.0

config BOARD_HPM_6750EVKMINI
	bool "HPMicro HPM_6750EVKMINI"
	depends on SOC_HPM6750
```

## boards/riscv/hpm6750evkmini/Kconfig.defconfig
```kconfig
# Copyright (c) 2022 hpmicro
# SPDX-License-Identifier: Apache-2.0

if BOARD_HPM_6750EVKMINI

config BOARD
	default "hpm6750evkmini"

endif #BOARD_HPM_6750EVKMINI
```

## drivers/gpio/Kconfig.hpmicro
```kconfig
# Copyright 2022 hpmicro
# SPDX-License-Identifier: Apache-2.0
DT_COMPAT_HPMICRO_HPM_GPIO := hpmicro,hpm-gpio

config GPIO_HPMICRO
	bool "HPMicro GPIO driver"
	depends on (SOC_SERIES_HPMICRO)
	depends on (HAS_HPMSDK_GPIO)
	default $(dt_compat_enabled,$(DT_COMPAT_HPMICRO_HPM_GPIO))
	select HAS_DTS_GPIO
	help
	  Enable the hpmicro gpio driver.
```

## drivers/pinctrl/Kconfig.hpmicro
```kconfig
# Copyright 2022 hpmicro
# SPDX-License-Identifier: Apache-2.0

DT_COMPAT_HPM_PINCTRL := hpmicro,hpm-pinctrl

config PINCTRL_HPMICRO
	bool "Pin controller driver for HPMicro MCUs"
	depends on (SOC_SERIES_HPMICRO)
	depends on (HAS_HPMSDK_PINCTRL)
	default $(dt_compat_enabled,$(DT_COMPAT_HPM_PINCTRL))
	help
	  Enable pin controller driver for HPMicro series MCUs
```

## drivers/serial/Kconfig.hpmicro
```kconfig
# Copyright 2022 hpmicro
# SPDX-License-Identifier: Apache-2.0


DT_COMPAT_HPM_UART := hpmicro,hpm-uart

config UART_HPM
	bool "HPMICRO serial driver"
	default $(dt_compat_enabled,$(DT_COMPAT_HPM_UART))
	depends on (SOC_SERIES_HPMICRO)
	depends on (HAS_HPMSDK_UART)
	select SERIAL_HAS_DRIVER
	select SERIAL_SUPPORT_INTERRUPT
	help
	  This option enables the UART driver for HPM SoC family.
```

## dts/bindings/pinctrl/hpmicro,hpm-pinctrl.yaml
```yaml
# Copyright 2022 hpmicro
# SPDX-License-Identifier: Apache-2.0

description: HPMicro PinMux

compatible: "hpmicro,hpm-pinctrl"

include:
    - name: base.yaml
    - name: pincfg-node-group.yaml
      child-binding:
        child-binding:
          property-allowlist:
            - drive-open-drain
            - input-enable
            - bias-disable
            - bias-pull-down
            - bias-pull-up
            - input-schmitt-enable

child-binding:
  description: HPMicro pin controller pin group
  child-binding:
    description: |
      HPMicro pin controller pin configuration node.
    properties:
      pinmux:
        required: true
        type: array
        description: |
          Represents pin mux settings. Use HPMICRO_PINMUX
          With:
          - pin: The gpio pin number (0, 1, ..., GPIO_NUM_MAX)
          - analog: bool, select analog pin in pad
          - alt_select: alt0-alt31
      drive-strength:
        required: false
        type: string
        default: "r000"
        enum:
          - "r000"
          - "r001"
          - "r010"
          - "r011"
          - "r100"
          - "r101"
          - "r110"
          - "r111"
      power-source:
        required: false
        type: string
        default: "v3_3"
        enum:
          - "v3_3"
          - "v1_8"
```

## dts/bindings/serial/hpmicro,hpm-uart.yaml
```yaml
# Copyright 2022 hpmicro
# SPDX-License-Identifier: Apache-2.0

description: HPMicro UART

compatible: "hpmicro,hpm-uart"

include: [uart-controller.yaml, pinctrl-device.yaml]

properties:
    reg:
      required: true

    interrupts:
      required: true

    clock-name:
      type: int
      description: Uart clock name
      required: true

    clock-src:
      type: int
      description: Uart clock src
      required: true
```

## soc/riscv/riscv-privilege/hpmicro/Kconfig.series
```kconfig
# Copyright 2022 hpmicro
# SPDX-License-Identifier: Apache-2.0

config SOC_SERIES_HPMICRO
	bool "HPMicro HPM6700_6400 Series"
	select RISCV
	select SOC_FAMILY_RISCV_PRIVILEGE
	select HAS_HPMICRO_HAL
	help
	  Enable support for HPMicro HPM6700_6400 series SoC
```

## soc/riscv/riscv-privilege/hpmicro/Kconfig.soc
```kconfig
# Copyright 2022 hpmicro
# SPDX-License-Identifier: Apache-2.0

choice
prompt "HPMicro HPM6700_6400 SoC Selection"
depends on SOC_SERIES_HPMICRO

config SOC_HPM6750
	bool "HPMicro HPM6750 SoC implementation"
	select ATOMIC_OPERATIONS_BUILTIN
	select INCLUDE_RESET_VECTOR
	select HAS_HPMSDK_UART
	select HAS_HPMSDK_GPIO
	select HAS_HPMSDK_PINCTRL
	select HAS_HPMSDK_PDM
	select HAS_HPMSDK_PLLCTL
	select HAS_HPMSDK_PMP

config SOC_HPM6360
	bool "HPMicro HPM6360 SoC implementation"
	select ATOMIC_OPERATIONS_BUILTIN
	select INCLUDE_RESET_VECTOR
	select HAS_HPMSDK_UART
	select HAS_HPMSDK_GPIO
	select HAS_HPMSDK_PINCTRL
	select HAS_HPMSDK_PDM
	select HAS_HPMSDK_PLLCTLV2
	select HAS_HPMSDK_PMP

endchoice

if SOC_SERIES_HPMICRO

choice
prompt "FPU options"
default SOC_HPMICRO_SINGLE_PRECISION_FPU

config SOC_HPMICRO_NO_FPU
	bool "No FPU"

config SOC_HPMICRO_SINGLE_PRECISION_FPU
	bool "Single precision FPU"
	select CPU_HAS_FPU

config SOC_HPMICRO_DOUBLE_PRECISION_FPU
	bool "Double precision FPU"
	select CPU_HAS_FPU_DOUBLE_PRECISION

endchoice

config SOC_HPMICRO_HWDSP
	bool "AndeStar V5 DSP ISA"
	select RISCV_SOC_CONTEXT_SAVE
	depends on !RISCV_GENERIC_TOOLCHAIN

endif # SOC_SERIES_HPMICRO
```
